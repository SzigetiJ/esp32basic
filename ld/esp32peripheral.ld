PROVIDE ( gsGPIO = 0x3ff44000 );
PROVIDE ( grIOMUX = 0x3ff49000 );
PROVIDE ( gsDPORT = 0x3ff00000);
PROVIDE ( gsPIDCTRL = 0x3ff1f000);
PROVIDE ( gsRTC = 0x3ff48000);
PROVIDE ( gsRMT = 0x3ff56000 );
PROVIDE ( grRMTRAM = 0x3ff56800 );
PROVIDE ( gsTIMG0 = 0x3ff5f000);
PROVIDE ( gsTIMG1 = 0x3ff60000);
PROVIDE ( gsI2C0 = 0x3ff53000);
PROVIDE ( gsI2C1 = 0x3ff67000);
PROVIDE ( gsUART0 = 0x60000000);
PROVIDE ( gsUART1 = 0x60010000);
PROVIDE ( gsUART2 = 0x602E0000);
PROVIDE ( gsUART0Mapped = 0x3ff40000);
PROVIDE ( gsUART1Mapped = 0x3ff50000);
PROVIDE ( gsUART2Mapped = 0x3ff6e000);

PROVIDE ( _impure_ptr = 0x3ffae0b0);
